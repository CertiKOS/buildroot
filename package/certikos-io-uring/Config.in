## package/certikos/Config.in
```kconfig
menu "CertiKOS, PARTEE, and RingLeader Packages"
	source "package/certikos/ringleader-proxy/Config.in"
	source "package/certikos/periodic-ping/Config.in"
	source "package/certikos/io-uring-perf/Config.in"
endmenu
```

## package/certikos/io-uring-perf/Config.in
```kconfig
config BR2_PACKAGE_IO_URING_PERF
	bool    "io-uring-perf"
	select BR2_PACKAGE_LIBURING
	help
		test
```

## package/certikos/ringleader-proxy/Config.in
```kconfig
config BR2_PACKAGE_RINGLEADER_PROXY
	bool    "ringleader-proxy"
	select BR2_PACKAGE_LIBURING
	help
		test
```
